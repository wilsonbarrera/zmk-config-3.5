## boards/shields/enki42/Kconfig.shield
```kconfig
# Copyright (c) 2020 The ZMK Contributors
# SPDX-License-Identifier: MIT

config SHIELD_ENKI42_LEFT
	def_bool $(shields_list_contains,enki42_left)

config SHIELD_ENKI42_RIGHT
	def_bool $(shields_list_contains,enki42_right)

config SHIELD_ENKI42_DONGLE
	def_bool $(shields_list_contains,enki42_dongle)

CONFIG_ZMK_SLEEP=y
CONFIG_ZMK_IDLE_SLEEP_TIMEOUT=900000
```
